// MeshRoute — tools/probe_inbox_verbs/transcript_main.cpp
// Author: Stanislaw Kozicki <cgpsmapper@gmail.com>
//
// ★★★ §RADMIN-0c — THE BEFORE/AFTER TRANSCRIPT + SIDE-EFFECT COMPARATOR.
//
// WHAT IT ANSWERS, in one sentence: **for every line in the inventory-derived matrix, does the USB shape and the
// BLE shape of `src/fw_main.cpp` produce THE SAME BYTES ON THE SAME SINKS AND THE SAME DEVICE-STATE DELTA before
// and after the 0c consolidation?** That is the entire C1 claim, and nothing weaker proves it.
//
// ⛔⛔ WHAT IT IS NOT, SAID FIRST SO NOBODY OVER-READS IT. **It does NOT compile `src/fw_main.cpp`.** No host build
//     can (g_node, mrnv, RadioLib, the board glue). The brief is explicit: *"No host probe compiles
//     `fw_main.cpp`; do not claim otherwise."* ⇒ the WIRING authority for 0c is (a) the real seam EXECUTED by the
//     X-rows of `probe_main.cpp` in this same directory, and (b) the STRUCTURAL adapter pins in
//     `tools/probe_console_sink/structural.py`. This file is the third, different thing: the **byte-identity
//     comparator** that makes the refactor auditable line by line.
//
// ★ AND IT IS AN EXTRACTION, NOT A TRANSCRIPTION — which is the only reason it is worth anything. The two caller
//   regions are lifted VERBATIM out of a REAL `fw_main.cpp` text by `transcript.py` (the `ble_guard.py` idiom:
//   unique-anchor-or-refuse), written into a generated header, and compiled here against the REAL
//   `src/firmware_commands.cpp`, the REAL `lib/core`/`lib/console`, the REAL `GuardedConsole` and the REAL
//   `LineSink`. A hand-copied caller would drift from the source the day the source changed; an extraction cannot.
//   ⇒ the BEFORE arm is re-derivable at any time from `git show <base>:src/fw_main.cpp`, so this is a MEASUREMENT,
//   not a frozen snapshot ([[B291]]'s trap: a gate whose only regeneration source is history).
//
// ⓘ THE FIXTURES ARE `probe_main.cpp`'S, NOT A SECOND SET (U1). This file `#include`s it with `MR0C_NO_MAIN`, so
//   the device context, the resettable inbox/NV/RNG fakes, `ble_capture` and the report primitive are literally the
//   same objects the 71-check gate uses.
//
// ⓘ FIDELITY NOTE, RECORDED BECAUSE IT BOUNDS A CLAIM: the shared Arduino fake's `print(v, RADIX)` ignores the
//   radix (`tools/probe_board_ui/fakes/Arduino.h`), so a `dh=0x…`/`lp=0x…` field renders DECIMAL here. The bytes
//   below are therefore the PROBE's rendering, not the board's — which is exactly what a BEFORE/AFTER identity
//   comparison needs (the same fake on both arms), and is why the `HEX` radix itself is pinned separately and
//   structurally (`structural.py` S27). ⛔ The fake is NOT edited: three other probes share it.
//
// ⓘ [[B487]] IT IS BUILT ONLY BY THE INBOX RUNNER'S OWN BUILDER (`transcript.py` B1), with the profile's arm: the
//   real router, handler, remote-action and client TUs, the arm's defines and `--wrap` flags. The extracted BLE
//   tail names `mrble::kLineStorageBytes`, so the REAL `device_ble.h` is included before the generated header —
//   no fake declaration. The generated header is found through `build_variant`'s shadow-include directory, which
//   holds it and nothing else (the angle form never searches this file's own directory).
#define MR0C_NO_MAIN
#include "probe_main.cpp"       // the fixtures + the real device context (U1: one fixture authority)
#include "device_ble.h"         // the real BLE line store the extracted BLE tail limits a line by
#include <mr0c_adapters.h>      // GENERATED by transcript.py: mr0c_serial_tail / mr0c_ble_tail + MR0C_MATRIX

// ================================================================================================================
// Deterministic rendering. Every byte is escaped, so an invisible difference (a lost '\r', a trailing space) is a
// visible difference in the transcript — the whole point of a byte comparator.
// ================================================================================================================
static void esc(const char* p, size_t n) {
    for (size_t i = 0; i < n; ++i) {
        const unsigned char c = (unsigned char)p[i];
        if      (c == '\r') printf("\\r");
        else if (c == '\n') printf("\\n");
        else if (c == '\\') printf("\\\\");
        else if (c < 0x20 || c > 0x7e) printf("\\x%02x", c);
        else putchar((int)c);
    }
}

// The device-state fingerprint. ⛔ NOT "the output looks the same": 0c must preserve every SIDE EFFECT, and the
// brief says so explicitly ("Output equality alone is not enough"). Each field is a production counter the real
// handlers move; `ctr` in particular is what makes "the command ran AT MOST ONCE" observable — a second
// `Node::on_command` on a send-family line advances it a second time.
struct Fp {
    unsigned ctr, txq, txdrop, rt, dm, ch, wipes, nvw, kh, pend, dmrec, chrec;
    char     routed[64];
};
static Fp fingerprint() {
    Fp f{};
    f.ctr    = (unsigned)g_node.peer_ctr_high();
    f.txq    = (unsigned)g_hal.txq_depth();
    f.txdrop = (unsigned)g_hal.txq_drops();
    f.rt     = (unsigned)g_node.rt_count();
    f.dm     = (unsigned)g_dm_store.set_next_calls;
    f.ch     = (unsigned)g_ch_store.set_next_calls;
    f.wipes  = (unsigned)(g_dm_store.wipe_calls + g_ch_store.wipe_calls);
    f.nvw    = (unsigned)mrprobe_nv().writes;
    f.kh     = (unsigned)g_node.key_hash32();
    f.pend   = g_node.has_pending_tx() ? 1u : 0u;
    f.dmrec  = (unsigned)g_dm_store.n_rec;
    f.chrec  = (unsigned)g_ch_store.n_rec;
    std::snprintf(f.routed, sizeof f.routed, "%s", g_routed);
    return f;
}
static void print_fp(const Fp& a, const Fp& b) {   // the DELTA, plus the absolutes a delta cannot express
    printf("ctr+%d txq=%u txdrop=%u rt=%u hw_dm+%u hw_ch+%u wipes+%u nvw+%d kh=%08x pend=%u recs=%u/%u routed=%s",
           (int)b.ctr - (int)a.ctr, b.txq, b.txdrop, b.rt, b.dm - a.dm, b.ch - a.ch, b.wipes - a.wipes,
           (int)b.nvw - (int)a.nvw, b.kh, b.pend, b.dmrec, b.chrec, b.routed[0] ? b.routed : "-");
}

// One clean slate before each arm. ⛔ It resets what a FAKE owns (the sinks, the NV medium, the RNG stream, the
// stub-call recorder); it deliberately does NOT reset `g_node`, because the ORDER of the matrix is identical on
// both arms, so the accumulated node state is identical too — and a reconstructed `Node` would be a different
// fixture, which is the one thing a byte comparator may not have.
static void arm_reset() {
    mrcon.service();
    Serial.reset();
    ble_reset();
    rng_reset();
    g_routed[0] = '\0';
    mrprobe_nv().writes = 0;
}

int main() {
    // ★ [[B488]] EVERY ROW MUST FIT THE USB INTAKE ARRAY, checked BEFORE a byte of the ledger is printed: the serial
    //   tail receives `service_console`'s own array type (`Mr0cUsbLine`), and that array — in production as here —
    //   holds only a line SHORTER than itself. A row this driver cannot represent is refused by name, never cut.
    for (const auto& row : MR0C_MATRIX) {
        const size_t len = std::strlen(row.line);
        if (len >= sizeof(Mr0cUsbLine)) {
            std::fprintf(stderr, "MR0C-REFUSED row %s len=%u cannot be represented in the USB intake array "
                                 "(%u bytes, %u admitted) — a transcript row must be shorter than the array\n",
                         row.id, (unsigned)len, (unsigned)sizeof(Mr0cUsbLine), (unsigned)sizeof(Mr0cUsbLine) - 1);
            return 4;
        }
    }

    // The identity/NV medium starts healthy and DETERMINISTIC, exactly as the R-rows leave it, so `regen`,
    // `peerkey` and the /mrid readers see a production-written record rather than an empty medium — and, as W0's
    // R-rows do, the LIVE name/position that `regen` and `whoami` read is installed from that same record.
    install_live_name_pos(seed_id("transcript", 10, 0x20));
    seed_inbox(3, 2);

    printf("MR0C-TRANSCRIPT v1 adapters=%s lines=%u\n", MR0C_ADAPTERS_ID,
           (unsigned)(sizeof MR0C_MATRIX / sizeof MR0C_MATRIX[0]));
    // ★ THE COMPILED PROFILE, PRINTED BY THE BINARY AND CHECKED BY THE GENERATOR. The matrix is projected for a
    //   NAMED profile; if this arm's macros were not that profile the projection would list verbs this build does
    //   not compile (and omit ones it does), and the transcript would quietly measure the wrong surface. Found
    //   exactly that way: the arm is `full_headless`, not `full_oled`, because `MR_FEAT_OLED` is an explicit
    //   per-env `-D` and this probe's arm does not pass it. ⓘ All FIVE inventory macros ([[B487]]): the remote-admin
    //   pair is what tells `full_headless` (accept) from `mobile` (client).
    printf("MR0C-PROFILE MR_N_LAYERS=%d MR_FEAT_MOBILE=%d MR_FEAT_OLED=%d MR_FEAT_RADMIN_ACCEPT=%d "
           "MR_FEAT_RADMIN_CLIENT=%d\n", (int)MR_N_LAYERS, (int)MR_FEAT_MOBILE, (int)MR_FEAT_OLED,
           (int)MR_FEAT_RADMIN_ACCEPT, (int)MR_FEAT_RADMIN_CLIENT);

    for (const auto& row : MR0C_MATRIX) {
        const size_t len = std::strlen(row.line);

        printf("LINE %s len=%u [", row.id, (unsigned)len);
        esc(row.line, len);
        printf("]\n");

        // ---- the USB shape ------------------------------------------------------------------------------------
        arm_reset();
        const Fp a1 = fingerprint();
        Mr0cUsbLine line{};                    // `service_console`'s array type: `sizeof(line) - 1` is production's
        std::memcpy(line, row.line, len);      // len < sizeof(line), checked above
        line[len] = '\0';                      // the terminator `service_console` writes before the tail
        mr0c_serial_tail(line, len);
        mrcon.service();                       // the once-per-loop-pass drain `service_console` performs
        const Fp b1 = fingerprint();
        printf("  SER usb=["); esc(Serial.out, Serial.n_out);
        printf("] ble=["); esc(g_ble, g_ble_n);
        printf("] fp="); print_fp(a1, b1); printf("\n");

        // ---- the BLE shape ------------------------------------------------------------------------------------
        arm_reset();
        const Fp a2 = fingerprint();
        static char out[256];                  // fw_main.cpp's `g_out` capacity, verbatim (device_ble.h:202)
        std::memset(out, 0, sizeof out);
        const size_t n = mr0c_ble_tail(row.line, len, out, sizeof out);
        mrcon.service();
        const Fp b2 = fingerprint();
        printf("  BLE ret=%u buf=[", (unsigned)n); esc(out, n > sizeof out ? sizeof out : n);
        printf("] nus=["); esc(g_ble, g_ble_n);
        printf("] usb=["); esc(Serial.out, Serial.n_out);
        printf("] fp="); print_fp(a2, b2); printf("\n");
    }
    // ⓘ This driver asserts NOTHING about the bytes — it is a ledger, and `transcript.py` validates it against the
    //   expected matrix and compares two of them; its only refusal is a row it cannot represent (above). The two
    //   counters are `probe_main.cpp`'s and are printed (at zero) so the reader can see that no CHK row ran here
    //   and must not read this program's exit code as a gate verdict.
    printf("MR0C-TRANSCRIPT END chk=%d fail=%d\n", g_chk, g_fail);
    return 0;
}
